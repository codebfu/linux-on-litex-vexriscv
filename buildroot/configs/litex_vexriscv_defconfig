## buildroot/configs/litex_vexriscv_defconfig
```kconfig
#
# Target options
#
BR2_riscv=y
BR2_RISCV_32=y

#
# Instruction Set Extensions
#
BR2_riscv_custom=y
BR2_RISCV_ISA_CUSTOM_RVM=y
BR2_RISCV_ISA_CUSTOM_RVA=y
BR2_RISCV_ISA_CUSTOM_RVC=n
BR2_RISCV_ABI_ILP32=y

# GCC
BR2_GCC_VERSION_8_X=y
BR2_GCC_VERSION="8.3.0"

# System
BR2_TARGET_GENERIC_GETTY=y
BR2_TARGET_GENERIC_GETTY_PORT="console"
BR2_TARGET_GENERIC_HOSTNAME="rasprack"
BR2_TARGET_GENERIC_ISSUE="Welcome to Rasprack OS"
BR2_TARGET_GENERIC_ROOT_PASSWD="toor"
BR2_TARGET_GENERIC_PASSWD_SHA512=y
#BR2_INIT_SYSTEMD=y

# System advanced
BR2_PACKAGE_XZ=y
BR2_PACKAGE_ZIP=y
BR2_PACKAGE_NMON=y
BR2_PACKAGE_MMC_UTILS=y
BR2_PACKAGE_DMRAID=y
#BR2_PACKAGE_PYTHON3=y
#BR2_PACKAGE_PYTHON3_PYC_ONLY=y
#BR2_PACKAGE_PYTHON3_READLINE=y
#BR2_PACKAGE_PYTHON3_SSL=y
#BR2_PACKAGE_PYTHON3_XZ=y
#BR2_PACKAGE_PYTHON3_ZLIB=y
#BR2_PACKAGE_PYTHON_PIP=y
#BR2_PACKAGE_IPUTILS=y
#BR2_PACKAGE_IPUTILS_PING=y
#BR2_PACKAGE_IPUTILS_TRACEPATH=y
#BR2_PACKAGE_NTP=y
#BR2_PACKAGE_NANO=y
#BR2_PACKAGE_NANO_TINY=y

# Filesystem
BR2_TARGET_ROOTFS_CPIO=y

# Kernel (litex-hub/litex-vexriscv--linux5.0_sd_card branch)
BR2_PACKAGE_HOST_LINUX_HEADERS_CUSTOM_5_0=y
BR2_LINUX_KERNEL=y
BR2_LINUX_KERNEL_CUSTOM_GIT=y
BR2_LINUX_KERNEL_CUSTOM_REPO_URL="git://github.com/codebfu/linux2.git"
BR2_LINUX_KERNEL_CUSTOM_REPO_VERSION="c318e1ce9d43334ad0fa3e6c18de9d3d1647be25"
BR2_LINUX_KERNEL_USE_CUSTOM_CONFIG=y
BR2_LINUX_KERNEL_CUSTOM_CONFIG_FILE="$(BR2_EXTERNAL_LITEX_VEXRISCV_PATH)/board/litex_vexriscv/linux.config"
BR2_LINUX_KERNEL_IMAGE=y

# rootfs customisation
BR2_ROOTFS_OVERLAY="$(BR2_EXTERNAL_LITEX_VEXRISCV_PATH)/board/litex_vexriscv/rootfs_overlay"

# Extra packages
#BR2_PACKAGE_DHRYSTONE=y
#BR2_PACKAGE_MICROPYTHON=y
#BR2_PACKAGE_SPIDEV_TEST=y
#BR2_PACKAGE_MTD=y
#BR2_PACKAGE_MTD_JFFS_UTILS=y
```
